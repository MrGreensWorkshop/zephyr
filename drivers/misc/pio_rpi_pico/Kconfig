## drivers/misc/pio_rpi_pico/Kconfig
```kconfig
# Copyright (c) 2022 TOKITA Hiroshi <tokita.hiroshi@fujitsu.com>
# SPDX-License-Identifier: Apache-2.0

# Workaround for not being able to have commas in macro arguments

DT_COMPAT_RASPBERRYPI_PICO_PIO := raspberrypi,pico-pio

config PIO_RPI_PICO
	bool "RaspberryPi Pico PIO"
	#default y
        default $(dt_compat_enabled,$(DT_COMPAT_RASPBERRYPI_PICO_PIO))
```

## dts/bindings/misc/raspberrypi,pico-pio.yaml
```yaml
# Copyright (c) 2022, TOKITA Hiroshi <tokita.hiroshi@fujitsu.com>
# SPDX-License-Identifier: Apache-2.0

description: Raspberry Pi Pico PIO

compatible: "raspberrypi,pico-pio"

include: [base.yaml, pinctrl-device.yaml, reset-device.yaml]
```

## samples/boards/rpi_pico/pio_uart/sample.yaml
```yaml
sample:
  description: RaspberryPi Pico PIO based UART sample
  name: pio_uart
tests:
  sample.board.rpi_pico.pio_uart:
    platform_allow: rpi_pico
    tags: display
```
